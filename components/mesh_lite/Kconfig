## components/mesh_lite/Kconfig
```kconfig
menu "ESP Wi-Fi Mesh Lite"
    config MESH_LITE_ENABLE
        bool "Enable Mesh-Lite"
        default n
        select BRIDGE_STATION_CANCEL_AUTO_CONNECT_WHEN_DISCONNECTED
        depends on BRIDGE_DATA_FORWARDING_NETIF_SOFTAP
        help
            Enable Mesh-Lite

    menu "Mesh-Lite info configuration"
        depends on MESH_LITE_ENABLE
        config MESH_LITE_VENDOR_ID_0
            int "VENDOR_ID_0 for Mesh-Lite"
            default 71

        config MESH_LITE_VENDOR_ID_1
            int "VENDOR_ID_1 for Mesh-Lite"
            default 87

        config MESH_LITE_ID
            int "MESH_ID for Mesh-Lite"
            default 77

        config MESH_LITE_MAX_ROUTER_NUMBER
            int "Maximum number of trace router number"
            default 3
            range 1 5

        config MESH_LITE_MAXIMUM_LEVEL_ALLOWED
            int "The maximum level allowed"
            default 5
            range 1 15

        config MESH_LITE_NODE_INFO_REPORT
            bool "Enable node info report"
            default n
            help
                Sub-nodes report information regularly,
                and the root node collects and summarizes the mesh nodes information.

        config MESH_LITE_REPORT_INTERVAL
            depends on MESH_LITE_NODE_INFO_REPORT
            int "Report time interval(s)"
            default 300

        config MESH_LITE_MAXIMUM_NODE_NUMBER
            depends on MESH_LITE_NODE_INFO_REPORT
            int "The maximum node number"
            default 50
            range 1 200

        config JOIN_MESH_WITHOUT_CONFIGURED_WIFI_INFO
            bool "Join Mesh without configured with information"
            default y
            help
                Join the mesh network directly when starting up, regardless of whether Wi-Fi information is configured or not.
                If disabled, it will only join the mesh network after configuring Wi-Fi information.

        config JOIN_MESH_IGNORE_ROUTER_STATUS
            bool "Join Mesh no matter whether the node is connected to router"
            default n
            help
                If enabled, it will join Mesh no matter whether the node is connected to router

        config LEAF_NODE
            bool "Configure the node as a leaf node"
            default n

        config DEVICE_CATEGORY
                string "Device Category"
                default "ESP32"
                help
                    The device category, such as Light, Fun.
    endmenu

    config ESP_MESH_LITE_OTA_ENABLE
        bool "Enable Mesh-Lite OTA"
        default n
        help
            Enable Mesh-Lite OTA,
            When the device receives an OTA instruction, it will first request new firmware from the parent node,
            if the parent node does not have one, it will continue to request from a higher-level node, and so on up to the root node,
            if the root node also does not have the corresponding version firmware, then the upgrade will begin from the external URL.

    menu "Mesh-Lite OTA"
        depends on ESP_MESH_LITE_OTA_ENABLE
        config OTA_DATA_LEN
            int "Transmission data length of each packet"
            default 1376
            range 512 1376
            help
                Setting a smaller default OTA_DATA_LEN size can save some RAM,
                but the time spent by OTA will increase.

        config OTA_WND_DEFAULT
            int "Default receive window size"
            default 8256
            range OTA_DATA_LEN 8256
            help
                Must be a multiple of OTA_data_Len

        config OTA_AUTO_RESTART
            bool "After OTA successfully, chip restarts automatically"
            default y

        config OTA_AUTO_CANCEL_ROLLBACK
            bool "After OTA successfully, cancel the rollback automatically"
            default y
    endmenu

    config MESH_LITE_PROV_ENABLE
        bool "Enable Mesh-Lite Provisioning"
        default n
        help
            Enable Mesh-Lite Provisioning

    menu "Mesh Lite Wi-Fi Provisioning Configuration"
        depends on MESH_LITE_PROV_ENABLE
        choice MESH_LITE_PROV_TRANSPORT
            bool "Provisioning Transport"
            default MESH_LITE_PROV_TRANSPORT_BLE
            help
                Wi-Fi provisioning component offers both, SoftAP and BLE transports. Choose any one.

            config MESH_LITE_PROV_TRANSPORT_SOFTAP
                bool "SoftAP"

            config MESH_LITE_PROV_TRANSPORT_BLE
                bool "BLE"
                select BT_ENABLED
                depends on !IDF_TARGET_ESP32S2
        endchoice

        choice PROV_SECURITY_VERSION
            bool "Protocomm security version"
            default PROV_SECURITY_VERSION_2
            help
                Wi-Fi provisioning component offers 3 security versions.
                The component offers a choice between security version 1 and 2.

            config PROV_SECURITY_VERSION_1
                bool "Security version 1"
                select ESP_PROTOCOMM_SUPPORT_SECURITY_VERSION_1

            config PROV_SECURITY_VERSION_2
                bool "Security version 2"
                select ESP_PROTOCOMM_SUPPORT_SECURITY_VERSION_2
        endchoice

        choice PROV_MODE
            bool "Security version 2 mode"
            depends on PROV_SECURITY_VERSION_2
            default PROV_SEC2_DEV_MODE

            config PROV_SEC2_DEV_MODE
                bool "Security version 2 development mode"
                depends on PROV_SECURITY_VERSION_2
                help
                    This enables the development mode for security version 2.
                    Please note that this mode is NOT recommended for production purpose.

            config PROV_SEC2_PROD_MODE
                bool "Security version 2 production mode"
                depends on PROV_SECURITY_VERSION_2
                help
                    This enables the production mode for security version 2.
        endchoice

        config MESH_LITE_PROV_TRANSPORT
            int
            default 1 if MESH_LITE_PROV_TRANSPORT_BLE

        config PROV_RESET_PROVISIONED
            bool
            default n
            prompt "Reset provisioned status of the device"
            help
                This erases the NVS to reset provisioned status of the device on every reboot.
                Provisioned status is determined by the Wi-Fi STA configuration, saved on the NVS.

        config PROV_RESET_PROV_MGR_ON_FAILURE
            bool
            default y
            prompt "Reset provisioned credentials and state machine after session failure"
            help
                Enable reseting provisioned credentials and state machine after session failure.
                This will restart the provisioning service after retries are exhausted.

        config PROV_MGR_MAX_RETRY_CNT
            int
            default 5
            prompt "Max retries before reseting provisioning state machine"
            depends on PROV_RESET_PROV_MGR_ON_FAILURE
            help
                Set the Maximum retry to avoid reconnecting to an inexistent AP or if credentials
                are misconfigured. Provisioned credentials are erased and internal state machine
                is reset after this threshold is reached.

        config PROV_RELEASE_BLE_MEMORY_AFTER_PROVISIONED
            bool "Release BLE memory after provisioned"
            default y
            help
                If this option is enabled, it will release the BLE memory for other usage,
                but you can not perform Wi-Fi provision again until the device restarts.
                If you need to perform Wi-Fi provision multiple times without restarting the device, please disable this configuration.

        config PROV_SHOW_QR
            bool "Show provisioning QR code"
            default y
            help
                Show the QR code for provisioning.

        config PROV_USING_BLUEDROID
            bool
            depends on (BT_BLUEDROID_ENABLED && (IDF_TARGET_ESP32C3 || IDF_TARGET_ESP32S3))
            select BT_BLE_42_FEATURES_SUPPORTED
            default y
            help
                This enables BLE 4.2 features for Bluedroid.

        config DEFAULT_SSID_PREFIX
            string "Default SSID Prefix"
            default "Mesh_Lite"
            help
                The default SSID prefix used for the device.
                This will be used to form the SoftAP SSID with the device's MAC address.

        config PROV_TIMEOUT_SECONDS
            int "Provisioning timeout in seconds"
            default 300
            help
                The time in seconds for which the device will wait for provisioning to complete.
                If the device is not provisioned within this time, the device will exit provisioning mode.

        config CUSTOMER_DATA_LENGTH
            int "Customer data length"
            default 40

        config DEVICE_INFO_LENGTH
            int "Device information length"
            default 40

        config ZERO_PROV_LISTENING_TIMEOUT
            int "Zero Provisioning listening timeout"
            default 360
    endmenu

    config MESH_LITE_WIRELESS_DEBUG
        bool "Enabel Wireless Debug"
        default n

endmenu
```

## examples/mesh_local_control/main/Kconfig.projbuild
```kconfig
menu "Example Configuration"

config ROUTER_SSID
    string "Router SSID"
        default "ROUTER_SSID"
        help
            Router SSID.

config ROUTER_PASSWORD
    string "Router password"
        default "ROUTER_PASSWORD"
        help
            Router password.

config SERVER_IP
    string "Server IP address"
        default "192.168.0.1"
        help
            Server IP address.

config SERVER_PORT
    int "Server port"
        default "8070"
        help
            Server port.

endmenu
```

## examples/mesh_wifi_provisioning/main/Kconfig.projbuild
```kconfig
menu "Example Configuration"

config SERVER_IP
    string "Server IP address"
        default "192.168.0.1"
        help
            Server IP address.

config SERVER_PORT
    int "Server port"
        default "8070"
        help
            Server port.

endmenu
```

## examples/no_router/main/Kconfig.projbuild
```kconfig
menu "Example Configuration"

    config MESH_ROOT
        select JOIN_MESH_IGNORE_ROUTER_STATUS
        bool "Root device"
        default n
        help
            Configure the root device type.

    config MESH_CHANNEL
        int "Mesh network channel"
        range 1 14
        default 11
        help
            Mesh network channel.

endmenu
```

## examples/rainmaker/led_light/sdkconfig.defaults.esp32
```kconfig
# ESP RainMaker Config
CONFIG_ESP_RMAKER_ASSISTED_CLAIM=y

CONFIG_FREERTOS_PLACE_FUNCTIONS_INTO_FLASH=y
CONFIG_FREERTOS_PLACE_SNAPSHOT_FUNS_INTO_FLASH=y
CONFIG_RINGBUF_PLACE_FUNCTIONS_INTO_FLASH=y

CONFIG_COMPILER_OPTIMIZATION_SIZE=y
```

## examples/rainmaker/led_light/sdkconfig.defaults.esp32c2
```kconfig
# ESP RainMaker Config
CONFIG_ESP_RMAKER_NO_CLAIM=y

# ESP RainMaker App Wi-Fi Provisioning
CONFIG_APP_WIFI_PROV_SHOW_QR=n

# Hardware Settings
CONFIG_XTAL_FREQ_26=y

# Log output
CONFIG_LOG_DEFAULT_LEVEL_INFO=y
CONFIG_LOG_COLORS=y

# Compiler options
CONFIG_COMPILER_OPTIMIZATION_SIZE=y
CONFIG_COMPILER_OPTIMIZATION_ASSERTIONS_SILENT=y

# Wi-Fi
CONFIG_ESP32_WIFI_ENABLED=y
CONFIG_ESP32_WIFI_SW_COEXIST_ENABLE=y
CONFIG_ESP32_WIFI_STATIC_RX_BUFFER_NUM=2
CONFIG_ESP32_WIFI_DYNAMIC_RX_BUFFER_NUM=4
CONFIG_ESP32_WIFI_DYNAMIC_TX_BUFFER=y
CONFIG_ESP32_WIFI_TX_BUFFER_TYPE=1
CONFIG_ESP32_WIFI_DYNAMIC_TX_BUFFER_NUM=4
CONFIG_ESP32_WIFI_AMPDU_TX_ENABLED=y
CONFIG_ESP32_WIFI_TX_BA_WIN=4
CONFIG_ESP32_WIFI_AMPDU_RX_ENABLED=y
CONFIG_ESP32_WIFI_RX_BA_WIN=4
CONFIG_ESP32_WIFI_NVS_ENABLED=y
CONFIG_ESP32_WIFI_SOFTAP_BEACON_MAX_LEN=752
CONFIG_ESP32_WIFI_MGMT_SBUF_NUM=12
CONFIG_ESP32_WIFI_ENABLE_WPA3_SAE=y
CONFIG_ESP32_WIFI_ENABLE_WPA3_OWE_STA=y
CONFIG_ESP_WIFI_STA_DISCONNECTED_PM_ENABLE=y
CONFIG_ESP_WIFI_SOFTAP_SUPPORT=y
CONFIG_ESP_WIFI_ESPNOW_MAX_ENCRYPT_NUM=2

# TCP
CONFIG_LWIP_MAX_ACTIVE_TCP=10
CONFIG_LWIP_MAX_LISTENING_TCP=10
CONFIG_LWIP_TCP_HIGH_SPEED_RETRANSMISSION=y
CONFIG_LWIP_TCP_MAXRTX=12
CONFIG_LWIP_TCP_SYNMAXRTX=12
CONFIG_LWIP_TCP_MSS=624
CONFIG_LWIP_TCP_TMR_INTERVAL=250
CONFIG_LWIP_TCP_MSL=60000
CONFIG_LWIP_TCP_FIN_WAIT_TIMEOUT=20000
CONFIG_LWIP_TCP_SND_BUF_DEFAULT=2440
CONFIG_LWIP_TCP_WND_DEFAULT=2440
CONFIG_LWIP_TCP_RECVMBOX_SIZE=6
CONFIG_LWIP_TCP_QUEUE_OOSEQ=y
CONFIG_LWIP_TCP_OVERSIZE_MSS=y
CONFIG_LWIP_TCP_RTO_TIME=1500
```

## examples/rainmaker/led_light/sdkconfig.defaults.esp32c6
```kconfig
# ESP RainMaker Config
CONFIG_ESP_RMAKER_NO_CLAIM=y

# ESP RainMaker App Wi-Fi Provisioning
CONFIG_APP_WIFI_PROV_SHOW_QR=n

# Log output
CONFIG_LOG_DEFAULT_LEVEL_INFO=y
CONFIG_LOG_COLORS=y

# Compiler options
CONFIG_COMPILER_OPTIMIZATION_SIZE=y
CONFIG_COMPILER_OPTIMIZATION_ASSERTIONS_SILENT=y
```

## examples/rainmaker/provisioning_controller/main/Kconfig.projbuild
```kconfig
menu "Distribution Network Controller Example"

    menu "Button Configuration"
        config APP_GPIO_BUTTON_SW1
            default 16 if IDF_TARGET_ESP32   || IDF_TARGET_ESP32H2
            default 38 if IDF_TARGET_ESP32S2 || IDF_TARGET_ESP32S3
            default 9
            int "GPIO button of switch"
            help
                Set the GPIO button of switch.
    endmenu

    menu "ESPNOW Configuration"

        config ESPNOW_PMK
            string "ESPNOW primary master key"
            default "pmk1234567890123"
            help
                ESPNOW primary master for the example to use. The length of ESPNOW primary master must be 16 bytes.

        config ESPNOW_CHANNEL
            int "Channel"
            default 1
            range 0 14
            help
                The channel on which sending and receiving ESPNOW data.

    endmenu

endmenu
```

## examples/rainmaker_led_light/sdkconfig.defaults
```kconfig
CONFIG_ESPTOOLPY_FLASHSIZE_4MB=y
CONFIG_LWIP_ESP_LWIP_ASSERT=n
CONFIG_LWIP_L2_TO_L3_COPY=y
CONFIG_LWIP_IP_FORWARD=y
CONFIG_LWIP_IPV4_NAPT=y
CONFIG_LWIP_TCP_MSS=624
CONFIG_LWIP_TCP_OVERSIZE_MSS=y

CONFIG_PARTITION_TABLE_CUSTOM=y
CONFIG_PARTITION_TABLE_CUSTOM_FILENAME="partition_table/partitions_4MB.csv"
CONFIG_PARTITION_TABLE_FILENAME="partition_table/partitions_4MB.csv"
CONFIG_PARTITION_TABLE_OFFSET=0x8000
CONFIG_PARTITION_TABLE_MD5=y

# ESP RainMaker Config
CONFIG_ESP_RMAKER_USER_ID_CHECK=y
CONFIG_ESP_RMAKER_OTA_AUTOFETCH=y
CONFIG_ESP_RMAKER_OTA_AUTOFETCH_PERIOD=6
CONFIG_ESP_RMAKER_USE_CERT_BUNDLE=n
CONFIG_ESP_RMAKER_MQTT_USE_CERT_BUNDLE=n

# Enable Local Control by default
CONFIG_ESP_RMAKER_LOCAL_CTRL_ENABLE=y
CONFIG_ESP_RMAKER_LOCAL_CTRL_SECURITY_0=y

# mbedtls
CONFIG_MBEDTLS_DYNAMIC_BUFFER=y
CONFIG_MBEDTLS_DYNAMIC_FREE_PEER_CERT=y
CONFIG_MBEDTLS_DYNAMIC_FREE_CONFIG_DATA=y
CONFIG_MBEDTLS_CERTIFICATE_BUNDLE_DEFAULT_CMN=y

# For BLE Provisioning using NimBLE stack (Not applicable for ESP32-S2)
CONFIG_BT_ENABLED=y
CONFIG_BTDM_CTRL_MODE_BLE_ONLY=y
CONFIG_BT_NIMBLE_ENABLED=y
CONFIG_BT_NIMBLE_MAX_CONNECTIONS=5
CONFIG_BT_NIMBLE_ROLE_CENTRAL=n
CONFIG_BT_NIMBLE_ROLE_OBSERVER=n

# Temporary Fix for Timer Overflows
CONFIG_FREERTOS_TIMER_TASK_STACK_DEPTH=4096

# ESP Wi-Fi Mesh Lite
CONFIG_MESH_LITE_ENABLE=y
CONFIG_BRIDGE_USE_WEB_SERVER=n
CONFIG_BRIDGE_SOFTAP_SSID_END_WITH_THE_MAC=y
CONFIG_JOIN_MESH_WITHOUT_CONFIGURED_WIFI_INFO=n

CONFIG_APP_WIFI_PROV_NAME_PREFIX="MESH"
```
