## examples/rainmaker_led_light/sdkconfig.defaults.esp32c3
```kconfig
# Bootloader config
CONFIG_BOOTLOADER_APP_ROLLBACK_ENABLE=y
CONFIG_BOOTLOADER_SKIP_VALIDATE_IN_DEEP_SLEEP=y
CONFIG_BOOTLOADER_SKIP_VALIDATE_ON_POWER_ON=y
CONFIG_BOOTLOADER_SKIP_VALIDATE_ALWAYS=y
CONFIG_BOOTLOADER_LOG_LEVEL_WARN=y

# ESP RainMaker Config
CONFIG_ESP_RMAKER_SELF_CLAIM=y

# ESP RainMaker App Wi-Fi Provisioning
CONFIG_APP_WIFI_PROV_SHOW_QR=n

# Log output
CONFIG_LOG_DEFAULT_LEVEL_INFO=y
CONFIG_LOG_COLORS=y

# Compiler options
CONFIG_COMPILER_OPTIMIZATION_SIZE=y
CONFIG_COMPILER_OPTIMIZATION_ASSERTIONS_SILENT=y

# Newlib
CONFIG_NEWLIB_NANO_FORMAT=y

# Virtual file system
CONFIG_VFS_SUPPORT_DIR=n
CONFIG_VFS_SUPPORT_SELECT=n
CONFIG_VFS_SUPPORT_TERMIOS=n

# ESP NETIF Adapter
CONFIG_ESP_NETIF_TCPIP_ADAPTER_COMPATIBLE_LAYER=n

# Common ESP-related
CONFIG_ESP_ERR_TO_NAME_LOOKUP=n

# ESP-MQTT Configurations
CONFIG_MQTT_TRANSPORT_WEBSOCKET=n

# Wi-Fi
CONFIG_ESP_WIFI_FTM_INITIATOR_SUPPORT=n
CONFIG_ESP_WIFI_FTM_RESPONDER_SUPPORT=n

# PHY
CONFIG_ESP_PHY_MAX_WIFI_TX_POWER=20
```

## examples/wireless_debug/main/Kconfig.projbuild
```kconfig
menu "Example Configuration"

config ROUTER_SSID
    string "Router SSID"
        default "ROUTER_SSID"
        help
            Router SSID.

config ROUTER_PASSWORD
    string "Router password"
        default "ROUTER_PASSWORD"
        help
            Router password.

config APP_GPIO_BUTTON_SW1
    default 16 if IDF_TARGET_ESP32   || IDF_TARGET_ESP32H2
    default 38 if IDF_TARGET_ESP32S2 || IDF_TARGET_ESP32S3
    default 9
    int "GPIO button of switch"
    help
        Set the GPIO button of switch.

endmenu
```

## examples/wireless_debug/sdkconfig.defaults
```kconfig
# Override some defaults in mesh application project.

#
# FreeRTOS
#
CONFIG_FREERTOS_HZ=1000
CONFIG_FREERTOS_TIMER_TASK_STACK_DEPTH=3072
CONFIG_FREERTOS_USE_TRACE_FACILITY=y
CONFIG_FREERTOS_USE_STATS_FORMATTING_FUNCTIONS=y
CONFIG_FREERTOS_VTASKLIST_INCLUDE_COREID=y
CONFIG_FREERTOS_GENERATE_RUN_TIME_STATS=y

#
# ESP32-specific
#
CONFIG_ESP_TASK_WDT_PANIC=y
CONFIG_ESP_TASK_WDT_TIMEOUT_S=10
CONFIG_ESP_TIMER_TASK_STACK_SIZE=4096

# LWIP
CONFIG_LWIP_IP_FORWARD=y
CONFIG_LWIP_IPV4_NAPT=y

CONFIG_MESH_LITE_ENABLE=y
CONFIG_MESH_LITE_WIRELESS_DEBUG=y
CONFIG_BRIDGE_SOFTAP_SSID_END_WITH_THE_MAC=y
```
