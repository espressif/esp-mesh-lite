## mesh_root/main/Kconfig.projbuild
```kconfig
menu "Example Configuration"

config MESH_ROOT
    bool "Root device"
    select JOIN_MESH_IGNORE_ROUTER_STATUS
    default n
    help
      Set this device as the Mesh-Lite root node.

config MESH_CHANNEL
    int "Mesh network channel"
    range 1 14
    default 11
    help
      2.4 GHz Wi-Fi channel used by the Mesh-Lite backhaul.

menu "UART Bridge"

config UART_BRIDGE_PORT
    int "UART port number"
    range 0 2
    default 1
    help
      UART number used to forward logs/packets to the external DevKit.

config UART_BRIDGE_BAUD
    int "Baud rate"
    default 115200
    help
      UART baud rate.

config UART_BRIDGE_TX_PIN
    int "TX GPIO"
    default 17
    help
      GPIO used for UART TX (from mesh_root to DevKit).

config UART_BRIDGE_RX_PIN
    int "RX GPIO"
    default 18
    help
      GPIO used for UART RX (from DevKit back to mesh_root, if needed).

endmenu  # UART Bridge

endmenu  # Example Configuration
```
